## meta-wistron-net/conf/layer.conf
```bitbake
# We have a conf and classes directory, add to BBPATH
BBPATH .= ":${LAYERDIR}"

# We have recipes-* directories, add to BBFILES
BBFILES += "${LAYERDIR}/recipes-*/*/*.bb \
            ${LAYERDIR}/recipes-*/*/*.bbappend"

BBFILE_COLLECTIONS += "wistron-net-layer"
BBFILE_PATTERN_wistron-net-layer := "^${LAYERDIR}/"
LAYERSERIES_COMPAT_wistron-net-layer = "honister kirkstone"
```

## meta-wistron-net/conf/machine/include/wistron-net.inc
```bitbake
DISTROOVERRIDES .= ":wistron-net"

MACHINE_FEATURES += "\
        obmc-bmc-state-mgmt \
        obmc-phosphor-fan-mgmt \
        obmc-phosphor-flash-mgmt \
        obmc-chassis-state-mgmt \
        obmc-host-ipmi \
        obmc-host-state-mgmt \
        obmc-phosphor-chassis-mgmt \
        "

VIRTUAL-RUNTIME_skeleton_workbook = "${MACHINE}-config"

PREFERRED_PROVIDER_virtual/obmc-chassis-mgmt = "packagegroup-wistron-net-apps"
PREFERRED_PROVIDER_virtual/obmc-fan-mgmt = "packagegroup-wistron-net-apps"
PREFERRED_PROVIDER_virtual/obmc-flash-mgmt = "packagegroup-wistron-net-apps"
PREFERRED_PROVIDER_virtual/obmc-inventory-data ?= "${VIRTUAL-RUNTIME_skeleton_workbook}"
PREFERRED_PROVIDER_virtual/obmc-system-mgmt = "packagegroup-wistron-net-apps"
PREFERRED_PROVIDER_virtual/obmc-host-ipmi-hw ?= "phosphor-ipmi-kcs"

VIRTUAL-RUNTIME_obmc-host-state-manager ?= "x86-power-control"
VIRTUAL-RUNTIME_obmc-chassis-state-manager ?= "x86-power-control"

PREFERRED_VERSION_boost = "1.78.0"

# It has no ikvm feature for our network device.
IMAGE_FEATURES:remove = "obmc-ikvm"

# Most of our hardware uses the default ttyS4 at 115200.
# If platform has difference setting, it can be changed in <meta-platform>/conf/machine/<platform>.conf
SERIAL_CONSOLES:wistron-net = "115200;ttyS4"
```

## meta-wistron-net/meta-chita/conf/layer.conf
```bitbake
# We have a conf and classes directory, add to BBPATH
BBPATH .= ":${LAYERDIR}"

# We have recipes-* directories, add to BBFILES
BBFILES += "${LAYERDIR}/recipes-*/*/*.bb \
            ${LAYERDIR}/recipes-*/*/*.bbappend"

BBFILE_COLLECTIONS += "chita"
BBFILE_PATTERN_chita = "^${LAYERDIR}/"
LAYERSERIES_COMPAT_chita = "honister kirkstone"
```

## meta-wistron-net/meta-p3box/conf/distro/openbmc-p3box.conf
```bitbake
require conf/distro/openbmc-phosphor.conf

DISTRO_NAME = "Wistron Net OpenBMC P3 Box"
DISTRO_VERSION = "00.02.00"
```

## meta-wistron-net/meta-p3box/conf/layer.conf
```bitbake
# We have a conf and classes directory, add to BBPATH
BBPATH .= ":${LAYERDIR}"

# We have recipes-* directories, add to BBFILES
BBFILES += "${LAYERDIR}/recipes-*/*/*.bb \
            ${LAYERDIR}/recipes-*/*/*.bbappend"

BBFILE_COLLECTIONS += "p3box"
BBFILE_PATTERN_p3box = "^${LAYERDIR}/"
LAYERSERIES_COMPAT_p3box = "honister kirkstone"
```

## meta-wistron-net/meta-p3box/conf/machine/p3box.conf
```bitbake
KMACHINE = "aspeed"
KERNEL_DEVICETREE = "${KMACHINE}-bmc-wistron-net-${MACHINE}.dtb"

PREFERRED_PROVIDER_virtual/bootloader = "u-boot-aspeed-sdk"
PREFERRED_PROVIDER_u-boot = "u-boot-aspeed-sdk"
PREFERRED_PROVIDER_u-boot-fw-utils = "u-boot-fw-utils-aspeed-sdk"

UBOOT_DEVICETREE = "ast2500-evb"
UBOOT_MACHINE = "evb-ast2500_defconfig"

require conf/machine/include/wistron-net.inc
require conf/machine/include/ast2500.inc
require conf/machine/include/obmc-bsp-common.inc

MACHINE_FEATURES:remove = " obmc-host-ipmi"

PREFERRED_PROVIDER_virtual/obmc-host-ipmi-hw ?= ""
PREFERRED_PROVIDER_virtual/obmc-host-ctl ?= ""

FLASH_SIZE = "131072"
```

## meta-wistron-net/recipes-kernel/linux/linux-aspeed/drivers/hwmon/wistron/Kconfig
```kconfig
# SPDX-License-Identifier: GPL-2.0-only
#
# Wistron drivers configuration
#

config CPLD_SYSFS
	tristate "Wistron CPLD sysfs library"
	depends on I2C
	select WISTRON
	help
	  If you say yes here you get sysfs library for WISTRON CPLD.

config WISTRON_CPLD
	tristate "Wistron CPLD"
	depends on CPLD_SYSFS
	select WISTRON
	help
	  If you say yes here you get CPLD support WISTRON.

	  This driver can also be built as a module. If so, the module will
	  be called wistron_cpld.

config WISTRON
	tristate
```
